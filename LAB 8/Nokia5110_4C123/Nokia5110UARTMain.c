/*Nokia LCD Display*/

// Blue Nokia 5110
// ---------------
// Signal        (Nokia 5110) LaunchPad pin
// Reset         (RST, pin 1) connected to PA7
// SSI0Fss       (CE,  pin 2) connected to PA3
// Data/Command  (DC,  pin 3) connected to PA6
// SSI0Tx        (Din, pin 4) connected to PA5
// SSI0Clk       (Clk, pin 5) connected to PA2
// 3.3V          (Vcc, pin 6) power
// back light    (BL,  pin 7) not connected
// Ground        (Gnd, pin 8) ground

// Red SparkFun Nokia 5110 (LCD-10168)
// -----------------------------------
// Signal        (Nokia 5110) LaunchPad pin
// 3.3V          (VCC, pin 1) power
// Ground        (GND, pin 2) ground
// SSI0Fss       (SCE, pin 3) connected to PA3
// Reset         (RST, pin 4) connected to PA7
// Data/Command  (D/C, pin 5) connected to PA6
// SSI0Tx        (DN,  pin 6) connected to PA5
// SSI0Clk       (SCLK, pin 7) connected to PA2
// back light    (LED, pin 8) not connected
#include "PLL.h"
#include "tm4c123gh6pm.h"
#include <stdint.h>
#include "Nokia5110.h"
#include "PLL.h"
#include "UART.h"
#include "string.h"
void PortF_Init(void);


// delay function for testing from sysctl.c
// which delays 3*ulCount cycles

void Delay(unsigned long ulCount){
  do{
    ulCount--;
	}while(ulCount);
}


void OutCRLF(void){
  UART_OutChar(CR);
  UART_OutChar(LF);
}
// image of a IIITDM
const unsigned char Longhorn [] = {
0x00, 0x00, 0x00, 0x00, 0x00, 0x00, 0x00, 0x00, 0x00, 0x00, 0x00, 0x00, 0x80, 0x80, 0x00, 0x00,
0x00, 0x00, 0x30, 0xF8, 0xD8, 0x18, 0x30, 0x30, 0x60, 0x60, 0xC0, 0xFE, 0x7F, 0x03, 0x06, 0x06,
0x0C, 0x38, 0x30, 0x30, 0x30, 0x3C, 0x8F, 0xC3, 0xC1, 0x83, 0x1E, 0x3C, 0x30, 0x30, 0x38, 0x0C,
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0x00, 0x00, 0x00, 0x00, 0x00, 0x00, 0x00, 0x00,
};
// image of a I love ELE403P


const uint8_t Longhorn2[] ={0x00, 0x00, 0x00, 0x00, 0x00, 0x00, 0x00, 0x00, 0x00, 0x00, 0x00, 0x00, 0x00, 0x40, 0x40, 0xC0,
0xC0, 0xC0, 0xC0, 0xC0, 0x40, 0x40, 0x00, 0x00, 0x00, 0x00, 0x00, 0x00, 0x00, 0x00, 0x00, 0x00,
0x00, 0x00, 0x00, 0x00, 0x00, 0x80, 0x80, 0xC0, 0xC0, 0xC0, 0xC0, 0xC0, 0xC0, 0x80, 0x80, 0x00,
0x00, 0x00, 0x80, 0x80, 0xC0, 0xC0, 0xC0, 0xC0, 0xC0, 0xC0, 0x80, 0x80, 0x00, 0x00, 0x00, 0x00,
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0x00, 0x00, 0x00, 0x00, 0x00, 0x00, 0x00, 0x00, 
};

int main(void){
	//unsigned char i;
  char string[20];  // global to assist in debugging
//  unsigned long n;
//  uint32_t count = 0;
  PLL_Init(); 
	UART_Init();              // initialize UART
  OutCRLF();	// set system clock to 50 MHz
  Nokia5110_Init();
	Nokia5110_Clear();
  //for(count=0; count<2; count=count+1){
	//	UART_OutString("Wait ");
  // Nokia5110_DrawFullImage(Longhorn);
  //  Delay(16666667);                    // delay ~1 sec at 50 MHz
  // Nokia5110_DrawFullImage(Longhorn2);
   // Delay(16666667);                    // delay ~1 sec at 50 MHz
  //}
	
  

 Nokia5110_Clear();
	Nokia5110_SetCursor(0,0);
	PortF_Init();
           
  while(1){
		UART_OutString("Enter colour: ");
    UART_InString(string,19);
    //UART_OutString(" Your Text="); UART_OutString(string); OutCRLF();
		
	 	if( strcmp(string,"red")== 0){
				GPIO_PORTF_DATA_R = (0x02);
			Nokia5110_Clear();
	Nokia5110_SetCursor(0,0);
				UART_OutString("Red LED glowing");
		Nokia5110_OutString("Red LED glowing");}
		else if( strcmp(string,"blue")== 0){
				GPIO_PORTF_DATA_R = (0x04);
			Nokia5110_Clear();
	Nokia5110_SetCursor(0,0);
				UART_OutString("Blue LED glowing");
		Nokia5110_OutString("Blue LED glowing");}
		else if( strcmp(string,"green")== 0){
				GPIO_PORTF_DATA_R = (0x08);
			Nokia5110_Clear();
	Nokia5110_SetCursor(0,0);
				UART_OutString("Green LED glowing");
		Nokia5110_OutString("Green LED glowing");}
		else if( strcmp(string,"yellow")== 0){
				GPIO_PORTF_DATA_R = (0x0A);
			Nokia5110_Clear();
	Nokia5110_SetCursor(0,0);
			UART_OutString("Yellow LED glowing");
		Nokia5110_OutString("yellow LED glowing");}
		else if( strcmp(string,"cyan")== 0){
				GPIO_PORTF_DATA_R = (0x0C);
			Nokia5110_Clear();
	Nokia5110_SetCursor(0,0);
				UART_OutString("Cyan LED glowing");
		Nokia5110_OutString("Cyan LED glowing");}
		else if( strcmp(string,"pink")== 0){
				GPIO_PORTF_DATA_R = (0x06);
			Nokia5110_Clear();
	Nokia5110_SetCursor(0,0);
				UART_OutString("Pink LED glowing");
		Nokia5110_OutString("Pink LED glowing");}
		else if( strcmp(string,"white")== 0){
				GPIO_PORTF_DATA_R = (0x0E);
			Nokia5110_Clear();
	Nokia5110_SetCursor(0,0);
				UART_OutString("White LED glowing");
		Nokia5110_OutString("White LED glowing");}
		else{
				GPIO_PORTF_DATA_R = (0x00);
			Nokia5110_Clear();
	Nokia5110_SetCursor(0,0);
				UART_OutString("NO LED glowing");
		Nokia5110_OutString("NO LED glowing");}
		//Nokia5110_OutString(string);
		OutCRLF();
  //UART_OutChar('-');
 // UART_OutChar('-');
  //UART_OutChar('>');
	
  }
           
  
}

void PortF_Init(void)
{
	unsigned long delay;
	SYSCTL_RCGC2_R |= 0x20;// clock for Port F
	delay = SYSCTL_RCGC2_R;// wait 3-5 bus cycles 	
	GPIO_PORTF_LOCK_R = 0x4C4F434B;//unlock GPIOPortF
	GPIO_PORTF_CR_R = 0x1F; // allow changes to PF4-0
	// only PF0 to be unlocked, other bits can't be
	GPIO_PORTF_AMSEL_R = 0x00;// disable analog
	GPIO_PORTF_PCTL_R = 0x00;// bits for PF4-0
	GPIO_PORTF_DIR_R = 0x0E;// PF4,0 in, PF3,1 out
	GPIO_PORTF_AFSEL_R = 0x00;//disable alt func
	GPIO_PORTF_PUR_R = 0x11;// enable pullup on PF0,4 
	GPIO_PORTF_DEN_R = 0x1F;// enable digital I/O
}

